# file: UART_driver.ioc
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Mcu.Family=STM32L4
Mcu.Name=STM32L476R(C-E-G)Tx
Mcu.Package=LQFP64
NVIC.PriorityGroup=NVIC_PRIORITYGROUP_4
ProjectManager.HeapSize=0x200
ProjectManager.StackSize=0x400
ProjectManager.TargetToolchain=STM32CubeIDE
RCC.ADCFreq_Value=16000000
RCC.AHBFreq_Value=4000000
RCC.APB1Freq_Value=4000000
RCC.APB1TimFreq_Value=4000000
RCC.APB2Freq_Value=4000000
RCC.APB2TimFreq_Value=4000000
RCC.CortexFreq_Value=4000000
RCC.HCLKFreq_Value=4000000
RCC.HSE_VALUE=8000000
RCC.HSI_VALUE=16000000
RCC.LSE_VALUE=32768
RCC.MSI_VALUE=4000000
RCC.SYSCLKFreq_VALUE=4000000
RCC.USBFreq_Value=16000000
RCC.VCOOutputFreq_Value=32000000
board=custom

// file: Core/Src/main.c
/* USER CODE BEGIN Header */
/**
  ******************************************************************************
  * @file           : main.c
  * @brief          : Main program body
  ******************************************************************************
  * @attention
  *
  * Copyright (c) 2025 STMicroelectronics.
  * All rights reserved.
  *
  * This software is licensed under terms that can be found in the LICENSE file
  * in the root directory of this software component.
  * If no LICENSE file comes with this software, it is provided AS-IS.
  *
  ******************************************************************************
  */
/* USER CODE END Header */
#include "main.h"

/* USER CODE BEGIN PV */
uint8_t buffer[1] = {'s'}; //01000001 for 65
uint8_t RX_buffer[1] = {'a'}; // null character until received

/* USER CODE END PV */

void SystemClock_Config(void);

int main(void)
{

  /* USER CODE BEGIN 1 */

	//Peripheral Clock enable APB1 with it USART
	RCC -> APB1ENR1 |= RCC_APB1ENR1_USART2EN;
	RCC -> AHB2ENR |= RCC_AHB2ENR_GPIOAEN; //Enable GPIOA

	//Pin PA2 Setup,TX
	GPIOA -> MODER &= ~(GPIO_MODER_MODER2); //Clear PA2
	GPIOA -> MODER |= (1<<5); // 10 for Alternate Function mode
	GPIOA -> AFR[0] |= (7 << GPIO_AFRL_AFSEL2_Pos); //AF7 for TX
	//Pin PA3 Setup,RX
	GPIOA -> MODER &= ~(GPIO_MODER_MODER3); //Clear PA3, already 00 for input mode
	GPIOA -> MODER |= (2 << GPIO_MODER_MODE3_Pos); // 10 for Alternate Function mode
	GPIOA -> AFR[0] |= (7 << GPIO_AFRL_AFSEL3_Pos); //AF7 mode for RX

	//Setting up UART
	USART2 -> CR1 = 0x00000000; //Reset
	// USART2 -> CR1 = (1 << 28); //1 Start Bit, 8 data bit, n stop bits
	uint16_t uartdiv = 4000000 / 115200;
	USART2 -> BRR = (((uartdiv / 16) << USART_BRR_DIV_MANTISSA_Pos) | ((uartdiv % 16) << USART_BRR_DIV_FRACTION_Pos));

	//Enable Transmitter
	USART2 -> CR1 |= USART_CR1_TE;
	//Enable Receiver
	USART2 -> CR1 |= USART_CR1_RE;
	//Enable UART
	USART2 -> CR1 |= USART_CR1_UE;

	/*
	 * 	while (!(USART2->ISR & USART_ISR_TXE)) {}
	USART2 -> TDR = buffer[0];
	while (!(USART2->ISR & USART_ISR_TC)) {}

	while (!(USART2->ISR & USART_ISR_TXE)) {}
	USART2 -> TDR = RX_buffer[0];
	while (!(USART2->ISR & USART_ISR_TC)) {}
	 *
	 *
	 */

	  /* USER CODE END 1 */

  /* MCU Configuration--------------------------------------------------------*/

  /* Reset of all peripherals, Initializes the Flash interface and the Systick. */
  HAL_Init();

  /* Configure the system clock */
  SystemClock_Config();

  /* Initialize all configured peripherals */

  /* Infinite loop */
  /* USER CODE BEGIN WHILE */
  USART2->TDR = 'h';
  while (1)
  {
    /* USER CODE END WHILE */

    /* USER CODE BEGIN 3 */
	  while (!(USART2 -> ISR & USART_ISR_RXNE));

	  RX_buffer[0] = USART2 -> RDR;

	  while (!(USART2->ISR & USART_ISR_TXE)) {}
	  USART2 -> TDR = RX_buffer[0];
	  while (!(USART2->ISR & USART_ISR_TC)) {}

	  HAL_Delay(100);

  }
  /* USER CODE END 3 */
}

void SystemClock_Config(void)
{
  RCC_OscInitTypeDef RCC_OscInitStruct = {0};
  RCC_ClkInitTypeDef RCC_ClkInitStruct = {0};

  /** Configure the main internal regulator output voltage
  */
  if (HAL_PWREx_ControlVoltageScaling(PWR_REGULATOR_VOLTAGE_SCALE1) != HAL_OK)
  {
    Error_Handler();
  }

  /** Initializes the RCC Oscillators according to the specified parameters
  * in the RCC_OscInitTypeDef structure.
  */
  RCC_OscInitStruct.OscillatorType = RCC_OSCILLATORTYPE_MSI;
  RCC_OscInitStruct.MSIState = RCC_MSI_ON;
  RCC_OscInitStruct.MSICalibrationValue = 0;
  RCC_OscInitStruct.MSIClockRange = RCC_MSIRANGE_6;
  RCC_OscInitStruct.PLL.PLLState = RCC_PLL_NONE;
  if (HAL_RCC_OscConfig(&RCC_OscInitStruct) != HAL_OK)
  {
    Error_Handler();
  }

  /** Initializes the CPU, AHB and APB buses clocks
  */
  RCC_ClkInitStruct.ClockType = RCC_CLOCKTYPE_HCLK|RCC_CLOCKTYPE_SYSCLK
                              |RCC_CLOCKTYPE_PCLK1|RCC_CLOCKTYPE_PCLK2;
  RCC_ClkInitStruct.SYSCLKSource = RCC_SYSCLKSOURCE_MSI;
  RCC_ClkInitStruct.AHBCLKDivider = RCC_SYSCLK_DIV1;
  RCC_ClkInitStruct.APB1CLKDivider = RCC_HCLK_DIV1;
  RCC_ClkInitStruct.APB2CLKDivider = RCC_HCLK_DIV1;

  if (HAL_RCC_ClockConfig(&RCC_ClkInitStruct, FLASH_LATENCY_0) != HAL_OK)
  {
    Error_Handler();
  }
}

void Error_Handler(void)
{
  __disable_irq();
  while (1)
  {
  }
}
